/* ************************************************************************** */
/** Descriptive File Name

  @Company
    Smart Slug Bin

  @File Name
    TopSM.h

  @Summary
  Contains the top level state machine of Smart Slug Bin

  @Description
  The Top level of Smart Slug Bin consists of 3 states that are changed by a User
  Event , generated by the proximity sensor, an Item Event generated by an IR
  Sensor or Load Cell, or a Timeout Event. The 3 States are IDLE, WAIT, and
  ACTIVE. In active the state machine will enter the sub-state machine, wmSM (Waste
  Management State Machine).

*/
/* ************************************************************************** */
#include "TopSM.h"
#include "wmSM.h"
#include "lmrSM.h"

/**
  @Function
    void runTopSM(void);

  @Summary
    This is the top level of the state machine.

  @Remarks
    Refer to the TopSM.h header for function usage details.
*/
SSB runlmrSM(SSB lmr)
{
  switch (lmr.lmrSMState) {
    case LMRINIT:
      lmr.lmrSMState = FORWARD;
      lmr.lmrtime = lmr.globalTime;
      lmr.command = "display " + lmr.type + " Clean " + String(lmr.weight); // command type contamination weight
      Serial.println(lmr.command); // sends command to transition to display
      Serial.print("Transition into FORWARD\n");
      break;
    case FORWARD:
//      Serial.println(lmr.globalTime);
//      Serial.println(lmr.lmrtime);
      if (lmr.type == "Aluminum" && (lmr.globalTime - lmr.lmrtime > BIN_1)) {
        lmr.lmrSMState = DROP;
        Serial.print("Transition into DROP\n");
        lmr.lmrtime = lmr.globalTime;
      } else if (lmr.type == "Glass" && (lmr.globalTime - lmr.lmrtime > BIN_2)) {
        lmr.lmrSMState = DROP;
        Serial.print("Transition into DROP\n");
        lmr.lmrtime = lmr.globalTime;
      } else if (lmr.type == "Plastic" && (lmr.globalTime - lmr.lmrtime > BIN_3)) {
        lmr.lmrSMState = DROP;
        Serial.print("Transition into DROP\n");
        lmr.lmrtime = lmr.globalTime;
      }
      break;
    case DROP:
      if (lmr.globalTime - lmr.lmrtime > DROP_TIMEOUT) {
        lmr.lmrSMState = REVERSE;
        Serial.print("Transition into REVERSE\n");
//        lmr.fill = checkBin();
      }
      break;
    case REVERSE:
      if (lmr.type == "Aluminum" && (lmr.globalTime - lmr.lmrtime > BIN_1)) {
        lmr.lmrSMState = LMRINIT;
        lmr.wmSMState = WMINIT;
        Serial.print("Transition lmr to INIT; Transition wm to INIT;Pass back NO_ITEM\n");
        lmr.item = NO_ITEM;
      } else if (lmr.type == "Glass" && (lmr.globalTime - lmr.lmrtime > BIN_2)) {
        lmr.lmrSMState = LMRINIT;
        lmr.wmSMState = WMINIT;
        lmr.item = NO_ITEM;
        Serial.print("Transition lmr to INIT; Transition wm to INIT;Pass back NO_ITEM\n");
      } else if (lmr.type == "Plastic" && (lmr.globalTime - lmr.lmrtime > BIN_3)) {
        lmr.lmrSMState = LMRINIT;
        lmr.wmSMState = WMINIT;
        lmr.item = NO_ITEM;
        Serial.print("Transition lmr to INIT; Transition wm to INIT;Pass back NO_ITEM\n");
      }
      break;
    default:
      break;
  }
  return lmr;
}

/* *****************************************************************************
  End of File
*/
