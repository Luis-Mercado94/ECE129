/* ************************************************************************** */
/** Descriptive File Name

  @Company
    Smart Slug Bin

  @File Name
    TopSM.h

  @Summary
  Contains the top level state machine of Smart Slug Bin

  @Description
  The Top level of Smart Slug Bin consists of 3 states that are changed by a User
  Event , generated by the proximity sensor, an Item Event generated by an IR
  Sensor or Load Cell, or a Timeout Event. The 3 States are IDLE, WAIT, and
  ACTIVE. In active the state machine will enter the sub-state machine, wmSM (Waste
  Management State Machine).

*/
/* ************************************************************************** */
#include "TopSM.h"
#include "wmSM.h"
#include "lmrSM.h"

const HX711 scale;

/**
  @Function
    void runTopSM(void);

  @Summary
    This is the top level of the state machine.

  @Remarks
    Refer to the TopSM.h header for function usage details.
    the SSB's name is top :)
*/
SSB runTopSM(SSB top)
{
  switch (top.topSMState)
  {
    //
    case TOPINIT:
      Serial.write("Init Top State\n");
      top.topSMState = IDLE;
      //      powerSettingsOne(); This is where power will come in with the level one settings and turning on of the device in order
      //Initialize the scale
//      Serial.write("Setting up scale\n");
//      scale.begin(LOADCELL_DOUT_PIN, LOADCELL_SCK_PIN);
//      scale.set_scale(855.2f);                    
//      scale.tare();
      Serial.write("Transition to IDLE\n");
      break;
    case IDLE:
//      top.user = checkProximitySensor();
      if (top.user == USER) {
        Serial.write("Transition to WAIT\n");
        top.topSMState = WAIT;
        top.waitTimeStart = top.globalTime;
      }
      break;
    case WAIT:
//      top.weight = scale.get_units(10); //ssb has a scale
      if ((top.globalTime - top.waitTimeStart) > WAIT_TIMEOUT)
      {
        top.topSMState = IDLE;
        Serial.write("Transition to IDLE\n");
        top.user == FALSE;
      }
      else if (top.weight > BASE_WEIGHT) //maybe change to: "else if(top.topSMState!=IDLE)" //also not sure what BASE_WEIGHT  should be
        //The bin doesn't change because it's not in IDLE. It's already != IDLE. It moves forward only if there's a detected change of weight(BASE_WEIGHT is in the configure file.
      {
        // Enable Motor & Actuator power switches here: 
//        delay(500);
//        top.weight = scale.get_units(10);
        top.topSMState = ACTIVE;
        Serial.print("Transition to ACTIVE item weight=");
        Serial.println(top.weight);
//        top.waitTimeStart = top.globalTime;
        top.item = ITEM;  
//        Serial.println(top.item);
      }
      break;
    case ACTIVE:
      if (top.item == ITEM) {
//        Serial.write("ENTERED ACTIVE With an ITEM");
//        top.topSMState = IDLE;
//        Serial.write("Transition to IDLE\n");
        top = runwmSM(top);
      }
      /*else if (top.globalTime - top.waitTimeStart == WAIT_TIMEOUT) {
        //      activate this state for testing purposes only
        top.topSMState = IDLE;
        Serial.write("Transition to IDLE\n");
        top.item = NO_ITEM;
        top.user = NO_USER;
      }*/
      else if (top.item == NO_ITEM && top.fill == FULL) {
        top.topSMState = LOCKED;
        top.command = "emailGS";
        Serial.println(top.command); // Send command to pi to transition to MESSAGE state to email Ground Services
        Serial.write("Transition to LOCKED\n"); 
        top.waitTimeStart = top.globalTime;
        //        lockBin();
        //        messageGS();
      }
      else if (top.item == NO_ITEM && top.fill == NOT_FULL) {
        top.topSMState = WAIT;
        Serial.write("Transition to WAIT\n");
        top.waitTimeStart = top.globalTime;

      }
      break;
    case LOCKED:
      //some button perhaps to to unlock and symbolize that GS has emptied the bin?
      if ((top.globalTime - top.waitTimeStart) > WAIT_TIMEOUT) {//      activate this state for testing purposes only
        top.topSMState = IDLE;
        Serial.write("Transition to IDLE\n");
        top.item = NO_ITEM;
        top.user = NO_USER;
      }
    default:
      break;
  }
  return top;
}

/* *****************************************************************************
  End of File
*/
